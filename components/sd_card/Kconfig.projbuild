## components/sd_card/Kconfig.projbuild
```kconfig
menu "SD CARD SPI"
    config MISO
        int "MISO PIN FOR SD CARD ADAPTER"
        default 19
        
    config MOSI
        int "MOSI PIN FOR SD CARD ADAPTER"
        default 23

    config CLK
        int "SCLK PIN FOR SD CARD ADAPTER"
        default 18

    config CS 
        int "CS PIN FOR SD CARD ADAPTER"
        default 25
endmenu
```

## components/wifi_ap/Kconfig.projbuild
```kconfig
menu "AP configuration"
    config ESP_WIFI_SSID
        string "WIFI SSID"
        default "esp_wifi"
        help
            SSID

    config ESP_WIFI_PASSWORD
        string "WIFI Password"
        default "esp230005"
        help
            Wifi Password

    config ESP_WIFI_CHANNEL
        int "WIFI Channel"
        range 1 13
        default 1
        help
            Wifi Channel

    config MAX_STA_CONN
        int "Maximal sta connection"
        default 4
        help
            Maximal sta connection

        config ESP_GTK_REKEYING_ENABLE
            bool "Enable GTK Rekeying"
            default y
            help
                Flag to enable GTK rekeying.

        config ESP_GTK_REKEY_INTERVAL
            int "GTK rekey interval"
            depends on ESP_GTK_REKEYING_ENABLE
            range 60 65535
            default 600
            help
                GTK rekeying interval in seconds.
endmenu

menu "LEDS"
    config WIFI_CONNECTED_LED
        int "WIFI_CONNECTED_LED"
        default 5

    config UPLOADING_LED
        int "UPLOADING_LED"
        default 6
endmenu
```

## main/Kconfig.projbuild
```kconfig
menu "PINS CONFIG"
    config BOTTOM_RIGHT
        int "bottom right button pin"
        default 13
    
    config BOTTOM_LEFT
        int "bottom left button pin"
        default 12
        
    config TOP_RIGHT
        int "top right pin"
        default 14
        
    config TOP_LEFT
        int "top right pin"
        default 27
endmenu
```
